#include <SoftwareSerial.h>

//TinyGPSCustom GpsFixType(gps, "GNGSA", 2);

SoftwareSerial SoftSerial(GPS_RX_PIN, GPS_TX_PIN);


static uint32_t tGps = 0;
static uint32_t tCheck = 0;
bool bGps = false;
float pAlt = 0.0;

//unsigned char serial2bufferRead[1000];        // 1000 is alot of memory!!

void updateGps () {
  while (SoftSerial.available()) {
    gps.encode(SoftSerial.read());
  }
  if (millis() - tCheck >= 5000) {
    tCheck = millis();
    if (gps.charsProcessed() < 10) {
#ifdef DEVMODE
      Serial.println("WARNING: No GPS data. Check wiring");
#endif
    }
  }
}

bool GPS_OK() {
  if (gps.location.age() < GPS_MIN_AGE && gps.hdop.value() < GPS_MIN_HDOP) {
    return true;
  }
  return false;
}

bool gpsStab() {
  if (fabs(pAlt - gps.altitude.meters()) < 0.5 || bGps == false) {
    tGps = millis();
  }
  if (millis() - tGps > GPS_STABLE) {                                   // If timer hasnt reset within 1 second altitude is stable
    bGps = false;                                               // Reset started flag
    return true;
  }
  else {
    bGps = true;
    pAlt = gps.altitude.meters();
    return false;
  }
}


bool setGpsHome() {
  if (bGps == true) {
    return true;
  }
  else {
    if (gps.satellites.value() >= GPS_MIN_SATS && GPS_OK() == true && gpsStab() == true ) {
      // Set home position
      settings.homeLatitude = gps.location.lat();           // Save home Lat
      settings.homeLongitude = gps.location.lng();          // Save home Long
      settings.homeAltitude = gps.altitude.meters();        // Save home gps altitude
      bGps = true;
#ifdef DEVMODE
      Serial.println("GPS Home position set");
#endif
      return true;
    }
    return false;
  }
}
void setupGps() {

#ifdef BAUD_TEST
  SoftSerial.begin(9600);
#endif

#ifdef BAUD_9600
  SoftSerial.begin(GPS_BAUD_INIT);
  delay(100);
  byte packet1[] = {0xB5, 0x62, 0x06, 0x00, 0x14, 0x00, 0x01, 0x00, 0x00, 0x00, 0xC0, 0x08, 0x00, 0x00, 0x80, 0x25, 0x00, 0x00, 0x07, 0x00, 0x03, 0x00, 0x00, 0x00, 0x00, 0x00, 0x92, 0xB5};
  sendPacket(packet1, sizeof(packet1));
  SoftSerial.end();
  SoftSerial.begin(9600);
#ifdef DEVMODE
  Serial.println("GPS baud set at 9600");
#endif
#endif

#ifdef BAUD_57600
  SoftSerial.begin(GPS_BAUD_INIT);
  delay(100);
  byte packet2[] = {0xB5, 0x62, 0x06, 0x00, 0x14, 0x00, 0x01, 0x00, 0x00, 0x00, 0xC0, 0x08, 0x00, 0x00, 0x00, 0xE1, 0x00, 0x00, 0x07, 0x00, 0x03, 0x00, 0x00, 0x00, 0x00, 0x00, 0xCE, 0xC9};
  sendPacket(packet2, sizeof(packet2));
  SoftSerial.end();
  SoftSerial.begin(57600);
  delay(100);
#ifdef DEVMODE
  Serial.println("GPS baud set at 57600");
#endif
#endif

#ifdef BAUD_115200
  SoftSerial.begin(GPS_BAUD_INIT);
  delay(100);
  byte packet3[] = {0xB5, 0x62, 0x06, 0x00, 0x14, 0x00, 0x01, 0x00, 0x00, 0x00, 0xC0, 0x08, 0x00, 0x00, 0x00, 0xC2, 0x01, 0x00, 0x07, 0x00, 0x03, 0x00, 0x00, 0x00, 0x00, 0x00, 0xB0, 0x7E};
  sendPacket(packet3, sizeof(packet3));
  SoftSerial.end();
  SoftSerial.begin(115200);
  delay(100);
#ifdef DEVMODE
  Serial.println("GPS baud set at 115200");
#endif
#endif

#ifdef FREQ_1_HZ
  byte packet4[] = {0xB5, 0x62, 0x06, 0x08, 0x06, 0x00, 0xE8, 0x03, 0x01, 0x00, 0x01, 0x00, 0x01, 0x39};
  sendPacket(packet4, sizeof(packet4));
#ifdef DEVMODE
  Serial.println("GPS update frequency set at 1 Hz");
#endif
#endif

#ifdef FREQ_5_HZ
  byte packet5[] = {0xB5, 0x62, 0x06, 0x08, 0x06, 0x00, 0xC8, 0x00, 0x01, 0x00, 0x01, 0x00, 0xDE, 0x6A};
  sendPacket(packet5, sizeof(packet5));
#ifdef DEVMODE
  Serial.println("GPS update frequency set at 5 Hz");
#endif
#endif

#ifdef FREQ_10_HZ
  byte packet6[] = {0xB5, 0x62, 0x06, 0x08, 0x06, 0x00, 0x64, 0x00, 0x01, 0x00, 0x01, 0x00, 0x7A, 0x12};
  sendPacket(packet6, sizeof(packet6));
#ifdef DEVMODE
  Serial.println("GPS update frequency set at 10 Hz");
#endif
#endif

#ifdef MODE_0
  byte packet7[] = {0xB5, 0x62, 0x06, 0x24, 0x24, 0x00, 0xFF, 0xFF, 0x00, 0x03, 0x00, 0x00, 0x00,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 0x7E, 0x3C};
  sendPacket(packet7, sizeof(packet7));
#ifdef DEVMODE
  Serial.println("GPS mode set 0");
#endif
#endif

#ifdef MODE_1
  byte packet8[] = {0xB5, 0x62, 0x06, 0x24, 0x24, 0x00, 0xFF, 0xFF, 0x06, 0x03, 0x00, 0x00, 0x00,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 0x84, 0x08};
  sendPacket(packet8, sizeof(packet8));
#ifdef DEVMODE
  Serial.println("GPS mode set 1");
#endif
#endif

#ifdef MODE_2
  byte packet8[] = {0xB5, 0x62, 0x06, 0x24, 0x24, 0x00, 0xFF, 0xFF, 0x07, 0x03, 0x00, 0x00, 0x00,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 0x85, 0x2A};
  sendPacket(packet8, sizeof(packet8));
#ifdef DEVMODE
  Serial.println("GPS mode set 2");
#endif
#endif

#ifdef MODE_4
  byte packet8[] = {0xB5, 0x62, 0x06, 0x24, 0x24, 0x00, 0xFF, 0xFF, 0x08, 0x03, 0x00, 0x00, 0x00,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 0x86, 0x4C};
  sendPacket(packet8, sizeof(packet8));
#ifdef DEVMODE
  Serial.println("GPS mode set 4");
#endif
#endif

#ifdef NMEA
  byte packet9[] = {0xB5, 0x62, 0x06, 0x01, 0x08, 0x00, 0xF0, 0x01, 0x01, 0x00, 0x00, 0x01, 0x01, 0x00, 0x03, 0x35};
  byte packet10[] = {0xB5, 0x62, 0x06, 0x01, 0x08, 0x00, 0xF0, 0x03, 0x01, 0x00, 0x00, 0x01, 0x01, 0x00, 0x05, 0x43};
  sendPacket(packet9, sizeof(packet9));
  sendPacket(packet10, sizeof(packet10));
#ifdef DEVMODE
  Serial.println("GPS nmea set");
#endif
#endif

#ifdef COG_FILTER
  byte packet11[] = {0xB5, 0x62, 0x06, 0x1E, 0x14, 0x00, 0x00, 0x00, 0x00, 0x00, 0x02, 0x00, 0x00, 0x00, 0x00, 0x00, 0x00, 0x00, 0x0A, 0x32, 0x00, 0x00, 0x99, 0x4C, 0x00, 0x00, 0x5B, 0x10};
  sendPacket(packet11, sizeof(packet11));
#ifdef DEVMODE
  Serial.println("GPS cog filter set");
#endif
#endif

  //SoftSerial.addMemoryForRead(serial2bufferRead, sizeof(serial2bufferRead));

#ifdef DEVMODE
  Serial.println("GPS setup complete");
#endif
}

void sendPacket(byte * packet, byte len) {
  for (byte i = 0; i < len; i++) {
    SoftSerial.write(packet[i]);
  }
}
